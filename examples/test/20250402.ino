// 기존 수시변경 print encoder position -> print encoder position per 50ms 로 변경 
// 

#include <AccelStepper.h>

// Config motor pin (DRIVER Mode)
const int motor1_stepPin = 38; // Step pin
const int motor1_dirPin = 40; // Direction pin

const int motor2_stepPin = 46; // Step pin
const int motor2_dirPin = 48; // Direction pin

const int motor3_stepPin = 22; // Step pin
const int motor3_dirPin = 24; // Direction pin

const int motor4_stepPin = 30; // Step pin
const int motor4_dirPin = 32; // Direction pin

// Config motor pin (FULL4WIRE Mode)
const int motor1_pin_1 = 2; // motor1_IN1
const int motor1_pin_2 = 3; // motor1_IN2
const int motor1_pin_3 = 4; // motor1_IN3
const int motor1_pin_4 = 5; // motor1_IN4

const int motor2_pin_1 = 6; // motor2_IN1
const int motor2_pin_2 = 7; // motor2_IN2
const int motor2_pin_3 = 8; // motor2_IN3
const int motor2_pin_4 = 9; // motor2_IN4

const int motor3_pin_1 = 10; // motor3_IN1
const int motor3_pin_2 = 10; // motor3_IN2
const int motor3_pin_3 = 10; // motor3_IN3
const int motor3_pin_4 = 10; // motor3_IN4

const int motor4_pin_1 = 10; // motor4_IN1
const int motor4_pin_2 = 10; // motor4_IN2
const int motor4_pin_3 = 10; // motor4_IN3
const int motor4_pin_4 = 10; // motor4_IN4

// 로터리 엔코더 핀 설정
const int encoderz_PinA = 19;
const int encoderz_PinB = 18;

const int encoderc_PinA = 21;
const int encoderc_PinB = 20;

// 엔코더 모니터링 모드 
bool encoderMonitorMode = false;

// 엔코더 카운터 변수
volatile long encoder_count = 0;
volatile long last_encoder_count = 0;

// 엔코더 상태 출력 시간 관리
unsigned long lastEncoderPrintTime = 0;
const unsigned long encoderPrintInterval = 50; // 50ms마다 엔코더 값 출력


// 모터 동작 상태 변수
bool isRunning = false;
bool emergencyStop = false;

// AccelStepper 객체 생성
AccelStepper stepper1(AccelStepper::FULL4WIRE, motor1_pin_1, motor1_pin_3, motor1_pin_2, motor1_pin_4);
AccelStepper stepper2(AccelStepper::FULL4WIRE, motor2_pin_1, motor2_pin_3, motor2_pin_2, motor2_pin_4);
// AccelStepper stepper3(AccelStepper::FULL4WIRE, motor3_pin_1, motor3_pin_3, motor3_pin_2, motor3_pin_4);
// AccelStepper stepper4(AccelStepper::FULL4WIRE, motor4_pin_1, motor4_pin_3, motor4_pin_2, motor4_pin_4);

// AccelStepper stepper1(AccelStepper::DRIVER, motor1_stepPin, motor1_dirPin);
// AccelStepper stepper2(AccelStepper::DRIVER, motor2_stepPin, motor2_dirPin);
AccelStepper stepper3(AccelStepper::DRIVER, motor3_stepPin, motor3_dirPin);
AccelStepper stepper4(AccelStepper::DRIVER, motor4_stepPin, motor4_dirPin);

// C1: {24, 26, 26, 30, 32, 36, 40, 44, 48, 50, 54, 56, 58,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 20, 20};
// 8436(n=519): {0, 2, 6, 8, 10, 14, 14, 16, 20, 22, 24, 26, 28,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 12, 10};
// 7336(n=481): {0, 2, 4, 4, 6, 8, 10, 14, 20, 28, 38, 46, 54,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 -10, -14};
// 7289(n=549): {0, 2, 4, 6, 8, 8, 10, 12, 14, 16, 20, 24, 28,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 14, 12};
// 6656(n=753): {0, 2, 4, 4, 6, 6, 8, 10, 12, 14, 18, 22, 28,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 4, 2};
// 7624(n=350): {0, 6, 20, 36, 50, 60, 70, 76, 88, 104, 106, 112, 116,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 24, 16};


// Array C
int C1[] = {0, 2, 4, 4, 6, 6, 8, 10, 12, 14, 18, 22, 28,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 4, 2};
int C2[] = {0, 2, 4, 4, 6, 6, 8, 10, 12, 14, 18, 22, 28,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 4, 2};
int C3[] = {24, 26, 26, 30, 32, 36, 40, 44, 48, 50, 54, 56, 58,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 20, 20};
int C4[] = {24, 26, 26, 30, 32, 36, 40, 44, 48, 50, 54, 56, 58,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 20, 20};

// 배열 크기 계산
const int arraySize1 = sizeof(C1) / sizeof(C1[0]);
const int arraySize2 = sizeof(C2) / sizeof(C2[0]);
const int arraySize3 = sizeof(C3) / sizeof(C3[0]);
const int arraySize4 = sizeof(C4) / sizeof(C4[0]);

// 작동 시간 측정 변수
unsigned long startTime = 0;
unsigned long endTime = 0;

// unsigned long totalTime;

// 엔코더 상태 출력 시간 관리
//unsigned long lastEncoderPrintTime = 0;
//const unsigned long encoderPrintInterval = 50; // default: 500ms마다 엔코더 값 출력

void setup() {
    Serial.begin(115200);
    Serial.println("-------------------------------------");
    Serial.println("Stepper Motor and Encoder Initialized");

    // 모터 속도 및 가속 설정
    stepper1.setMaxSpeed(1600);      // 최대 속도 (steps per second)
    stepper1.setAcceleration(800);   // 가속도 (steps per second^2)

    stepper2.setMaxSpeed(1600);      // 최대 속도 (steps per second)
    stepper2.setAcceleration(800);   // 가속도 (steps per second^2)

    stepper3.setMaxSpeed(1000);      // 최대 속도 (steps per second)
    stepper3.setAcceleration(500);   // 가속도 (steps per second^2)

    stepper4.setMaxSpeed(1000);      // 최대 속도 (steps per second)
    stepper4.setAcceleration(500);   // 가속도 (steps per second^2)

    // 배열 길이 일치 여부 확인
    if (arraySize1 == arraySize2 && arraySize2 == arraySize3 && arraySize3 == arraySize4) {
    Serial.println("All arrays have the same length.");
    } else {
    Serial.println("Warning: Array lengths do not match!");

    // 불일치하는 배열 쌍 출력
    if (arraySize1 != arraySize2) Serial.println("C2 differ in arraySize.");
    if (arraySize1 != arraySize3) Serial.println("C3 differ in arraySize.");
    if (arraySize1 != arraySize4) Serial.println("C4 differ in arraySize.");
    }

    // Config a rotary encdoer pin
    pinMode(encoderz_PinA, INPUT_PULLUP);
    pinMode(encoderz_PinB, INPUT_PULLUP);
    
    // Config the interrupt
    attachInterrupt(digitalPinToInterrupt(encoderz_PinA), Encoder_z_CW, RISING);
    attachInterrupt(digitalPinToInterrupt(encoderz_PinB), Encoder_z_CCW, RISING);

    // C 배열의 이론적 작동 시간 계산 및 출력
    int theoreticalTime = arraySize1 * 50;  // 각 위치당 50ms
    Serial.print("Expected operation time: ");
    printFormattedTime(theoreticalTime);

    // Min-Max calculation
    calculateMaxMin();

    Serial.println("Available commands:");
    Serial.println("a: Operate all motors simultaneously");
    Serial.println("1: Operate only motor 1");
    Serial.println("2: Operate only motor 2");
    Serial.println("3: Operate only motor 3");
    Serial.println("4: Operate only motor 4");

    Serial.println("e: Print current encoder value");
    Serial.println("r: Reset encoder value");
    Serial.println("w: Encoder toggle on/off");
    Serial.println("s: Emergency stop !!");
    Serial.println("m: Repeat motor movements with max and min values of C1");

}


void loop() {
    
    // 비상 정지 상태 확인
    if (emergencyStop) {
        // 비상 정지 상태일 때는 모터 동작 중지
        if (isRunning) {
            stopMotors();
            isRunning = false;
            Serial.println("Emergency stop activated. Motors stopped.");
        }
        
        // 비상 정지 상태 해제
        emergencyStop = false;
        Serial.println("Ready for new commands.");
    }

    // 시리얼 입력 확인 (비상 정지 포함)
    checkSerialInput();
}


// 시리얼 입력 확인 함수
void checkSerialInput() {
    if (Serial.available() > 0) {
        char command = Serial.read();

        // 비상 정지 명령 확인
        if (command == 's') {
            emergencyStop = true;
            return;
        }
        
        // 다른 명령어들 처리
        if (!isRunning) {  // 모터가 동작 중이 아닐 때만 다른 명령 처리
            if (command == 'a') {
                Serial.println("Moving all motors simultaneously");
                
                // 시작 시간 기록
                // recordCount = 0; // 기록 초기화
                startTime = millis();
                isRunning = true;
                Serial.println("Time(ms), Encoder Value");
                moveMotorByArray();
                isRunning = false;
                // 종료 시간 기록
                endTime = millis();
                
                // 총 소요 시간 계산 및 출력
                unsigned long totalTime = endTime - startTime;
                Serial.print("Total execution time: ");
                Serial.print(totalTime);
                Serial.println(" milliseconds");
            }
            else if (command == 'e') {
                // 엔코더 값 출력 명령
                Serial.print("Current encoder count: ");
                Serial.println(encoder_count);
            }
            else if (command == 'r') {
                // 엔코더 값 리셋 명령
                encoder_count = 0;
                Serial.println("Encoder count reset to 0");
            }
            else if (command == '1') {
                // 모터 1만 작동
                Serial.println("Moving only motor 1");
                // 시작 시간 기록
                // recordCount = 0; // 기록 초기화
                startTime = millis();
                isRunning = true;
                Serial.println("Time(ms), Encoder Value"); // 헤더 출력 추가
                moveSingleMotor(1);
                isRunning = false;
                // 종료 시간 기록
                endTime = millis();

                // 총 소요 시간 계산 및 출력
                unsigned long totalTime = endTime - startTime;
                Serial.print("Total execution time: ");
                Serial.print(totalTime);
                Serial.println(" milliseconds");
            }
            else if (command == '2') {
                // 모터 2만 작동
                Serial.println("Moving only motor 2");
                // 시작 시간 기록
                // recordCount = 0; // 기록 초기화
                startTime = millis();
                isRunning = true;
                Serial.println("Time(ms), Encoder Value"); // 헤더 출력 추가
                moveSingleMotor(2);
                isRunning = false;
                // 종료 시간 기록
                endTime = millis();

                unsigned long totalTime = endTime - startTime;
                Serial.print("Total execution time: ");
                Serial.print(totalTime);
                Serial.println(" milliseconds");
            }

            else if (command == '3') {
                Serial.println("Moving only motor 3");
                startTime = millis();
                isRunning = true;
                Serial.println("Time(ms), Encoder Value");
                moveSingleMotor(3);
                isRunning = false;
                endTime = millis();

                unsigned long totalTime = endTime - startTime;
                Serial.print("Total execution time: ");
                Serial.print(totalTime);
                Serial.println(" milliseconds");
            }
            else if (command == '4') {
                Serial.println("Moving only motor 4");
                startTime = millis();
                isRunning = true;
                Serial.println("Time(ms), Encoder Value");
                moveSingleMotor(4);
                isRunning = false;
                endTime = millis();

                unsigned long totalTime = endTime - startTime;
                Serial.print("Total execution time: ");
                Serial.print(totalTime);
                Serial.println(" milliseconds");
            }

            else if (command == 'm') { // 'm' 입력 시 반복 동작 실행
                repeatMaxMin();
            }
            
            else if (command == 'w') {
                // 엔코더 값 변화 모니터링 모드 토글
                encoderMonitorMode = !encoderMonitorMode;
                if (encoderMonitorMode) {
                    Serial.println("Encoder monitoring mode: ON - All encoder changes will be printed");
                } else {
                    Serial.println("Encoder monitoring mode: OFF");
                }
            }
        }
    }
}


// 모터 정지 함수
void stopMotors() {
    stepper1.stop(); // 감속하여 정지
    stepper2.stop(); // 감속하여 정지
    stepper3.stop(); // 감속하여 정지
    stepper4.stop(); // 감속하여 정지
    
    // 모터가 완전히 멈출 때까지 run() 함수 호출
    while (stepper1.isRunning() || stepper2.isRunning() || stepper3.isRunning() || stepper4.isRunning()) {
        stepper1.run();
        stepper2.run();
        stepper3.run();
        stepper4.run();
    }
    
    // 모터 출력 비활성화
    stepper1.disableOutputs();
    stepper2.disableOutputs();
    stepper3.disableOutputs();
    stepper4.disableOutputs();
}


// 배열 C에 따라 모터 움직임 구현 함수
void moveMotorByArray() {
    for (int i = 0; i < arraySize1; i++) {
        
        long targetPosition = C1[i]*4; // 배열 C의 값 사용
        long targetPosition2 = C2[i]*4; // 배열 C의 값 사용
        // long targetPosition3 = C3[i]*4; // 배열 C의 값 사용
        // long targetPosition4 = C4[i]*4; // 배열 C의 값 사용
        
        stepper1.moveTo(targetPosition);
        stepper2.moveTo(-targetPosition2);
        // stepper3.moveTo(targetPosition);
        // stepper4.moveTo(-targetPosition2);

        unsigned long stepStartTime = millis();
        while (millis() - stepStartTime < 50) { // 비차단 방식으로 실행
            // 이 루프 안에서도 시리얼 입력 확인

            if (Serial.available() > 0) {
                char command = Serial.read();
                if (command == 's') {  // 's'키를 비상 정지로 사용
                    Serial.println("Emergency stop activated!");
                    stopMotors();
                    return;  // 함수 종료
                }
            }
            stepper1.run();
            stepper2.run();
            // stepper3.run();
            // stepper4.run();
        }
        // print encoder position per 50ms
        Serial.println(encoder_count);
    }

    Serial.println("Completed all movements based on array C.");
}



// Move single motor
void moveSingleMotor(int motorNum) {
    int* array;
    AccelStepper* stepper;
    
    switch(motorNum) {
        case 1: array = C1; stepper = &stepper1; break;
        case 2: array = C2; stepper = &stepper2; break;
        case 3: array = C3; stepper = &stepper3; break;
        case 4: array = C4; stepper = &stepper4; break;
        default: return;
    }
    
    for (int i = 0; i < arraySize1; i++) {
        long targetPosition = array[i] * 4;
        stepper->moveTo(targetPosition);

        unsigned long stepStartTime = millis();
        while (millis() - stepStartTime < 50) {
            if (Serial.available() > 0) {
                char command = Serial.read();
                if (command == 's') {
                    Serial.println("Emergency stop activated!");
                    stopMotors();
                    return;
                }
            }
            stepper->run();
        }
        Serial.println(encoder_count);
    }
    Serial.print("Completed movements for motor ");
    Serial.println(motorNum);
}


// 시간을 포맷팅하여 출력하는 함수 (밀리초를 시:분:초.밀리초 형식으로 변환)
void printFormattedTime(unsigned long timeInMs) {
    // 밀리초를 시, 분, 초로 변환
    unsigned long ms = timeInMs % 1000;
    unsigned long totalSeconds = timeInMs / 1000;
    unsigned long seconds = totalSeconds % 60;
    unsigned long minutes = (totalSeconds / 60) % 60;
    unsigned long hours = totalSeconds / 3600;
    
    // 시:분:초.밀리초 형식으로 출력
    if (hours > 0) {
        Serial.print(hours);
        Serial.print("시간 ");
    }
    
    if (minutes > 0 || hours > 0) {
        Serial.print(minutes);
        Serial.print("분 ");
    }
    
    Serial.print(seconds);
    Serial.print(".");
    
    // 밀리초는 항상 3자리로 표시
    if (ms < 10) Serial.print("00");
    else if (ms < 100) Serial.print("0");
    
    Serial.print(ms);
    Serial.println("초");
}


// C1 배열의 최대값과 최소값 계산
int maxC1 = 0;
int minC1 = 1000;

// Min-Max calculation function
void calculateMaxMin() {
    for (int i = 0; i < arraySize1; i++) {
        if (C1[i] > maxC1) maxC1 = C1[i];
        if (C1[i] < minC1) minC1 = C1[i];
    }
    Serial.print("Max value in C1: ");
    Serial.println(maxC1);
    Serial.print("Min value in C1: ");
    Serial.println(minC1);
}


// 최대값과 최소값으로 모터를 반복 동작시키는 함수
void repeatMaxMin() {
    Serial.println("Repeating motor movements with max and min values of C1.");
    for (int repeat = 0; repeat < 10; repeat++) {
        // 최대값으로 동작
        long targetPositionMax = maxC1 * 4;
        stepper1.moveTo(targetPositionMax);
        stepper2.moveTo(-targetPositionMax);
        stepper3.moveTo(targetPositionMax);
        stepper4.moveTo(-targetPositionMax);

        while (stepper1.distanceToGo() != 0 || stepper2.distanceToGo() != 0) {
            if (Serial.available() > 0) {
                char command = Serial.read();
                if (command == 's') {  // 's'키를 비상 정지로 사용
                    Serial.println("Emergency stop activated!");
                    stopMotors();
                    return;  // 함수 종료
                }
            }
            stepper1.run();
            stepper2.run();
            // stepper3.run();
            // stepper4.run();
        }
        Serial.println("Completed movement to max value.");
        Serial.println(encoder_count);

        // 최소값으로 동작
        long targetPositionMin = minC1 * 4;
        stepper1.moveTo(targetPositionMin);
        stepper2.moveTo(-targetPositionMin);
        stepper3.moveTo(targetPositionMin);
        stepper4.moveTo(-targetPositionMin);

        while (stepper1.distanceToGo() != 0 || stepper2.distanceToGo() != 0) {
            if (Serial.available() > 0) {
                char command = Serial.read();
                if (command == 's') {  // 's'키를 비상 정지로 사용
                    Serial.println("Emergency stop activated!");
                    stopMotors();
                    return;  // 함수 종료
                }
            }
            stepper1.run();
            stepper2.run();
            // stepper3.run();
            // stepper4.run();
        }
        Serial.println("Completed movement to min value.");
        Serial.println(encoder_count);
    }
    stopMotors();
}


// 로터리 엔코더 시계방향(CW) 회전 감지 인터럽트 함수
void Encoder_z_CW() {
    if (digitalRead(encoderz_PinB) == LOW) {
        encoder_count++;
    }
    // else {
    //     encoder_count--;
    // }
}


// 로터리 엔코더 반시계방향(CCW) 회전 감지 인터럽트 함수
void Encoder_z_CCW() {
    if (digitalRead(encoderz_PinA) == LOW) {
        encoder_count--;
    }
    // else {
    //     encoder_count++;
    // }
}


